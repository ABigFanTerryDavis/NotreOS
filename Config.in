## Config.in
```kconfig
source "$BR2_EXTERNAL_NOTREOS_PATH/package/notre-boot/Config.in"
source "$BR2_EXTERNAL_NOTREOS_PATH/package/notre-init/Config.in"
source "$BR2_EXTERNAL_NOTREOS_PATH/package/notre-shell/Config.in"
```

## configs/notreos_x86_64_defconfig
```kconfig
BR2_x86_64=y
BR2_TOOLCHAIN_BUILDROOT_GLIBC=y
BR2_TOOLCHAIN_BUILDROOT_WCHAR=y
BR2_TOOLCHAIN_BUILDROOT_CXX=y
BR2_OPTIMIZE_S=y
BR2_REPRODUCIBLE=y
BR2_DOWNLOAD_FORCE_CHECK_HASHES=y

BR2_TARGET_GENERIC_HOSTNAME="notreos"
BR2_TARGET_GENERIC_ISSUE="NotreOS Ancient 0.0.1"
BR2_ROOTFS_DEVICE_CREATION_DYNAMIC_EUDEV=y
BR2_ROOTFS_OVERLAY="$(BR2_EXTERNAL_NOTREOS_PATH)/board/notreos/rootfs-overlay"
BR2_INIT_NONE=y
BR2_SYSTEM_BIN_SH_NONE=y
# BR2_TARGET_GENERIC_GETTY is not set
BR2_PACKAGE_BUSYBOX=y
BR2_PACKAGE_BUSYBOX_CONFIG_FRAGMENT_FILES="$(BR2_EXTERNAL_NOTREOS_PATH)/board/notreos/busybox.fragment"

BR2_KERNEL_HEADERS_7_1=y
BR2_LINUX_KERNEL=y
BR2_LINUX_KERNEL_CUSTOM_VERSION=y
BR2_LINUX_KERNEL_CUSTOM_VERSION_VALUE="7.1.13"
BR2_LINUX_KERNEL_USE_DEFCONFIG=y
BR2_LINUX_KERNEL_DEFCONFIG="x86_64"
BR2_LINUX_KERNEL_CONFIG_FRAGMENT_FILES="$(BR2_EXTERNAL_NOTREOS_PATH)/board/notreos/linux.fragment"
BR2_TARGET_ROOTFS_INITRAMFS=y
BR2_TARGET_ROOTFS_CPIO_XZ=y

BR2_TARGET_ROOTFS_EXT2=y
BR2_TARGET_ROOTFS_EXT2_4=y
BR2_TARGET_ROOTFS_EXT2_LABEL="NOTREOS"
BR2_TARGET_ROOTFS_EXT2_SIZE="192M"

BR2_ROOTFS_POST_IMAGE_SCRIPT="$(BR2_EXTERNAL_NOTREOS_PATH)/board/notreos/post-image.sh"

BR2_PACKAGE_GNU_EFI=y
BR2_PACKAGE_NOTRE_BOOT=y
BR2_PACKAGE_NOTRE_INIT=y
BR2_PACKAGE_NOTRE_SHELL=y

BR2_PACKAGE_DHCPCD=y
BR2_PACKAGE_OPENSSL=y
BR2_PACKAGE_XORG7=y
BR2_PACKAGE_XSERVER_XORG_SERVER=y
BR2_PACKAGE_XSERVER_XORG_SERVER_MODULAR=y
BR2_PACKAGE_XDRIVER_XF86_INPUT_LIBINPUT=y
BR2_PACKAGE_XDRIVER_XF86_VIDEO_FBDEV=y
BR2_PACKAGE_XDRIVER_XF86_VIDEO_VESA=y
BR2_PACKAGE_XFONT_FONT_MISC_MISC=y
BR2_PACKAGE_DILLO=y
```

## package/notre-boot/Config.in
```kconfig
config BR2_PACKAGE_NOTRE_BOOT
	bool "NotreBoot"
	depends on BR2_x86_64
	select BR2_PACKAGE_GNU_EFI
	help
	  NotreOS's own UEFI application. It loads the x86_64 Linux EFI-stub
	  kernel and passes a configurable command line from notreos.cfg.
```

## package/notre-init/Config.in
```kconfig
config BR2_PACKAGE_NOTRE_INIT
	bool "NotreInit"
	depends on BR2_USE_MMU
	select BR2_PACKAGE_NOTRE_SHELL
	help
	  NotreOS's own PID 1. It mounts early filesystems, resolves an optional
	  root= device, launches the system shell and starts the graphical session.
```

## package/notre-shell/Config.in
```kconfig
config BR2_PACKAGE_NOTRE_SHELL
	bool "NotreShell"
	depends on BR2_USE_MMU
	help
	  NotreOS's own small interactive command shell for Ancient 0.0.1.
	  It executes programs from PATH and implements a few basic built-ins.
```
